## Documentation/devicetree/bindings/clock/qcom,msm8994-cpucc.yaml
```yaml
# SPDX-License-Identifier: (GPL-2.0-only OR BSD-2-Clause)
%YAML 1.2
---
$id: http://devicetree.org/schemas/clock/qcom,msm8994-cpucc.yaml#
$schema: http://devicetree.org/meta-schemas/core.yaml#

title: Qualcomm MSM8994 CPU Clock Controller

maintainers:
  - Bjorn Andersson <andersson@kernel.org>

description: |
  The CPU clock controller of MSM8994 drives the two CPU clusters, each from
  a pair of PLLs and a pair of muxes.

  Clock specifier: 0 for the Cortex-A53 cluster, 1 for the Cortex-A57
  cluster.

properties:
  compatible:
    const: qcom,msm8994-cpucc

  reg:
    items:
      - description: Cortex-A53 cluster PLLs
      - description: Cortex-A57 cluster PLLs
      - description: Cortex-A57 cluster APCS global block

  clocks:
    items:
      - description: XO source

  clock-names:
    items:
      - const: xo

  '#clock-cells':
    const: 1

  qcom,apcs:
    $ref: /schemas/types.yaml#/definitions/phandle
    description:
      The APCS global block of the Cortex-A53 cluster, which holds that
      cluster's clock muxes besides the IPC mailbox.

  power-domains:
    maxItems: 1

  required-opps:
    maxItems: 1

required:
  - compatible
  - reg
  - clocks
  - clock-names
  - '#clock-cells'
  - qcom,apcs

additionalProperties: false

examples:
  - |
    clock-controller@f9015000 {
        compatible = "qcom,msm8994-cpucc";
        reg = <0xf9015000 0x1000>,
              <0xf9016000 0x1000>,
              <0xf900f000 0x1000>;
        clocks = <&xo_board>;
        clock-names = "xo";
        #clock-cells = <1>;
        qcom,apcs = <&apcs>;
    };
...
```

## Documentation/devicetree/bindings/net/qcom,msm8994-ipa.yaml
```yaml
# SPDX-License-Identifier: GPL-2.0 OR BSD-2-Clause
%YAML 1.2
---
$id: http://devicetree.org/schemas/net/qcom,msm8994-ipa.yaml#
$schema: http://devicetree.org/meta-schemas/core.yaml#

title: Qualcomm IP Accelerator (IPA) v2

maintainers:
  - davigamer987 <davimarchesiprimo@gmail.com>

description:
  The IPA is a hardware block that offloads network processing (filtering,
  routing, header insertion) between the application processor and the
  modem. Unlike IPA v3 and later, which present a GSI to each execution
  environment, IPA v2 is reached through the pipes of a BAM DMA controller
  shared with the modem. The AP uses its own pipes of that BAM for IPA
  commands and for network data to and from the modem.

properties:
  compatible:
    const: qcom,msm8994-ipa

  reg:
    items:
      - description: IPA registers
      - description: IPA-local shared memory

  reg-names:
    items:
      - const: ipa-reg
      - const: ipa-shared

  interrupts:
    maxItems: 1

  interrupt-names:
    const: ipa

  clocks:
    maxItems: 1

  clock-names:
    const: core

  interconnects:
    items:
      - description: Path leading to system memory
      - description: Path leading to internal memory

  interconnect-names:
    items:
      - const: memory
      - const: imem

  dmas:
    items:
      - description: AP LAN RX pipe
      - description: AP command TX pipe
      - description: AP to modem TX pipe
      - description: Modem to AP RX pipe

  dma-names:
    items:
      - const: ap_lan_rx
      - const: cmd_tx
      - const: ap_modem_tx
      - const: ap_modem_rx

required:
  - compatible
  - reg
  - reg-names
  - interrupts
  - interrupt-names
  - clocks
  - clock-names
  - interconnects
  - interconnect-names
  - dmas
  - dma-names

additionalProperties: false

examples:
  - |
    #include <dt-bindings/clock/qcom,rpmcc.h>
    #include <dt-bindings/interconnect/qcom,msm8994.h>
    #include <dt-bindings/interrupt-controller/arm-gic.h>

    ipa@fd4e0000 {
        compatible = "qcom,msm8994-ipa";
        reg = <0xfd4e0000 0x5000>,
              <0xfd4e5000 0x2000>;
        reg-names = "ipa-reg", "ipa-shared";
        interrupts = <GIC_SPI 301 IRQ_TYPE_EDGE_RISING>;
        interrupt-names = "ipa";
        clocks = <&rpmcc RPM_SMD_IPA_CLK>;
        clock-names = "core";
        interconnects = <&snoc SNOC_MAS_IPA &bimc BIMC_SLV_EBI_CH0>,
                        <&snoc SNOC_MAS_IPA &snoc SNOC_SLV_OCIMEM>;
        interconnect-names = "memory", "imem";
        dmas = <&ipa_bam 2>, <&ipa_bam 3>, <&ipa_bam 4>, <&ipa_bam 5>;
        dma-names = "ap_lan_rx", "cmd_tx", "ap_modem_tx", "ap_modem_rx";
    };
```

## Documentation/devicetree/bindings/phy/qcom,msm8994-qmp-pcie-phy.yaml
```yaml
# SPDX-License-Identifier: (GPL-2.0 OR BSD-2-Clause)
%YAML 1.2
---
$id: http://devicetree.org/schemas/phy/qcom,msm8994-qmp-pcie-phy.yaml#
$schema: http://devicetree.org/meta-schemas/core.yaml#

title: Qualcomm QMP PHY controller (PCIe, MSM8994)

maintainers:
  - Vinod Koul <vkoul@kernel.org>

description:
  The 20nm QMP PHY found next to each of the two PCIe root complexes of
  MSM8992 and MSM8994.

properties:
  compatible:
    const: qcom,msm8994-qmp-pcie-phy

  reg:
    items:
      - description: serdes

  clocks:
    maxItems: 4

  clock-names:
    items:
      - const: cfg_ahb
      - const: ref
      - const: ldo
      - const: pipe

  power-domains:
    maxItems: 1

  resets:
    maxItems: 2

  reset-names:
    items:
      - const: phy
      - const: common

  vdda-phy-supply: true

  vdda-pll-supply: true

  "#clock-cells":
    const: 0

  clock-output-names:
    maxItems: 1

  "#phy-cells":
    const: 0

required:
  - compatible
  - reg
  - clocks
  - clock-names
  - resets
  - reset-names
  - vdda-phy-supply
  - vdda-pll-supply
  - "#clock-cells"
  - clock-output-names
  - "#phy-cells"

additionalProperties: false

examples:
  - |
    #include <dt-bindings/clock/qcom,gcc-msm8994.h>
    #include <dt-bindings/clock/qcom,rpmcc.h>

    phy@fc52e000 {
        compatible = "qcom,msm8994-qmp-pcie-phy";
        reg = <0xfc52e000 0x1000>;

        clocks = <&gcc GCC_PCIE_1_CFG_AHB_CLK>,
                 <&rpmcc RPM_SMD_LN_BB_CLK>,
                 <&gcc PCIE_1_PHY_LDO>,
                 <&gcc GCC_PCIE_1_PIPE_CLK>;
        clock-names = "cfg_ahb",
                      "ref",
                      "ldo",
                      "pipe";

        clock-output-names = "pcie_1_pipe_clk";
        #clock-cells = <0>;

        #phy-cells = <0>;

        power-domains = <&gcc PCIE_1_GDSC>;

        resets = <&gcc PCIE_PHY_1_PHY_RESET>, <&gcc PCIE_PHY_1_RESET>;
        reset-names = "phy", "common";

        vdda-phy-supply = <&vreg_l28a_1p0>;
        vdda-pll-supply = <&vreg_l12a_1p8>;
    };
```

## Documentation/devicetree/bindings/sound/qcom,q6voice.yaml
```yaml
# SPDX-License-Identifier: GPL-2.0 OR BSD-2-Clause
%YAML 1.2
---
$id: http://devicetree.org/schemas/sound/qcom,q6voice.yaml#
$schema: http://devicetree.org/meta-schemas/core.yaml#

title: Qualcomm DSP voice services (Q6MVM, Q6CVS, Q6CVP)

maintainers:
  - davigamer987 <davimarchesiprimo@gmail.com>

description:
  The Multimode Voice Manager (MVM), Core Voice Stream (CVS) and Core Voice
  Processor (CVP) are APR services of the QDSP6 that carry circuit-switched
  voice calls between the modem vocoder and the audio ports. The MVM node
  holds the voice front-end DAI.

allOf:
  - $ref: /schemas/soc/qcom/qcom,apr-services.yaml#
  - if:
      properties:
        compatible:
          const: qcom,q6mvm
    then:
      required:
        - dais
    else:
      properties:
        dais: false

properties:
  compatible:
    enum:
      - qcom,q6cvp
      - qcom,q6cvs
      - qcom,q6mvm

  dais:
    type: object
    additionalProperties: false
    description: Voice call front end (CS-Voice)

    properties:
      compatible:
        const: qcom,q6voice-dais

      "#sound-dai-cells":
        const: 0

    required:
      - compatible
      - "#sound-dai-cells"

required:
  - compatible

unevaluatedProperties: false

examples:
  - |
    #include <dt-bindings/soc/qcom,apr.h>

    apr {
        #address-cells = <1>;
        #size-cells = <0>;

        service@9 {
            compatible = "qcom,q6mvm";
            reg = <APR_SVC_ADSP_MVM>;

            dais {
                compatible = "qcom,q6voice-dais";
                #sound-dai-cells = <0>;
            };
        };

        service@a {
            compatible = "qcom,q6cvs";
            reg = <APR_SVC_ADSP_CVS>;
        };

        service@b {
            compatible = "qcom,q6cvp";
            reg = <APR_SVC_ADSP_CVP>;
        };
    };
```

## Documentation/devicetree/bindings/sound/qcom,wcd9330.yaml
```yaml
# SPDX-License-Identifier: GPL-2.0-only OR BSD-2-Clause
%YAML 1.2
---
$id: http://devicetree.org/schemas/sound/qcom,wcd9330.yaml#
$schema: http://devicetree.org/meta-schemas/core.yaml#

title: Qualcomm WCD9330 Audio Codec

maintainers:
  - davigamer987 <davimarchesiprimo@gmail.com>

description:
  The Qualcomm WCD9330 is a standalone audio codec on SLIMbus with headphone,
  earpiece and line outputs, six analog microphone inputs and a headset jack
  detection block. It shows up on the bus as two devices, the codec itself and
  its interface device.

properties:
  compatible:
    const: slim217,130

  reg:
    maxItems: 1

  clocks:
    maxItems: 1

  clock-names:
    items:
      - const: mclk

  interrupts:
    maxItems: 1

  reset-gpios:
    maxItems: 1

  slim-ifc-dev:
    description: The interface device of the codec
    $ref: /schemas/types.yaml#/definitions/phandle

  '#sound-dai-cells':
    const: 1

  vdd-buck-supply:
    description: 2.15V supply of the class H buck converter

  vdd-tx-h-supply:
    description: 1.8V supply of the capture path

  vdd-rx-h-supply:
    description: 1.8V supply of the playback path

  vdd-px-supply:
    description: 1.8V I/O supply

  vdd-a-1p2v-supply:
    description: 1.2V analog supply

  vdd-cx1-supply:
    description: 1.2V digital core supply

  vdd-cx2-supply:
    description: 1.2V digital core supply

  qcom,micbias1-microvolt:
    description: Voltage of microphone bias 1
    minimum: 260000
    maximum: 2875000
    default: 1800000

  qcom,micbias2-microvolt:
    description: Voltage of microphone bias 2
    minimum: 260000
    maximum: 2875000
    default: 1800000

  qcom,micbias3-microvolt:
    description: Voltage of microphone bias 3
    minimum: 260000
    maximum: 2875000
    default: 1800000

  qcom,mbhc-insert-detect-inverted:
    description:
      The detection switch of the headset jack is open while a plug is
      inserted.
    type: boolean

  qcom,hph-class-ab:
    description:
      Run the headphone amplifiers in class AB from the charge pump instead of
      class H.
    type: boolean

required:
  - compatible
  - reg

allOf:
  - $ref: dai-common.yaml#
  - if:
      required:
        - slim-ifc-dev
    then:
      required:
        - clocks
        - clock-names
        - interrupts
        - reset-gpios
        - '#sound-dai-cells'
        - vdd-buck-supply
        - vdd-tx-h-supply
        - vdd-rx-h-supply
        - vdd-px-supply
        - vdd-a-1p2v-supply
        - vdd-cx1-supply
        - vdd-cx2-supply
    else:
      properties:
        clocks: false
        clock-names: false
        interrupts: false
        reset-gpios: false
        '#sound-dai-cells': false
        vdd-buck-supply: false
        vdd-tx-h-supply: false
        vdd-rx-h-supply: false
        vdd-px-supply: false
        vdd-a-1p2v-supply: false
        vdd-cx1-supply: false
        vdd-cx2-supply: false
        qcom,micbias1-microvolt: false
        qcom,micbias2-microvolt: false
        qcom,micbias3-microvolt: false
        qcom,mbhc-insert-detect-inverted: false
        qcom,hph-class-ab: false

additionalProperties: false

examples:
  - |
    #include <dt-bindings/clock/qcom,rpmcc.h>
    #include <dt-bindings/gpio/gpio.h>
    #include <dt-bindings/interrupt-controller/irq.h>

    slim {
        #address-cells = <2>;
        #size-cells = <0>;

        tomtom_ifd: codec@0,0 {
            compatible = "slim217,130";
            reg = <0 0>;
        };

        codec@1,0 {
            compatible = "slim217,130";
            reg = <1 0>;
            slim-ifc-dev = <&tomtom_ifd>;

            clocks = <&rpmcc RPM_SMD_DIV_CLK1>;
            clock-names = "mclk";
            interrupts-extended = <&tlmm 72 IRQ_TYPE_LEVEL_HIGH>;
            reset-gpios = <&tlmm 68 GPIO_ACTIVE_LOW>;

            vdd-buck-supply = <&vreg_s5a_2p15>;
            vdd-tx-h-supply = <&vreg_s4a_1p8>;
            vdd-rx-h-supply = <&vreg_s4a_1p8>;
            vdd-px-supply = <&vreg_s4a_1p8>;
            vdd-a-1p2v-supply = <&vreg_l11a_1p2>;
            vdd-cx1-supply = <&vreg_l11a_1p2>;
            vdd-cx2-supply = <&vreg_l11a_1p2>;

            qcom,micbias1-microvolt = <1800000>;
            qcom,micbias2-microvolt = <2700000>;
            qcom,micbias3-microvolt = <1800000>;
            qcom,mbhc-insert-detect-inverted;

            #sound-dai-cells = <1>;
        };
    };
```
